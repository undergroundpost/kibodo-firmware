## Kconfig
```kconfig
menuconfig KIBODO
    bool "Pair with the Kibodo companion app"
    depends on ZMK_SPLIT
    default n
    help
      Enables per-peripheral battery reporting and (optionally) metadata
      exchange between split peripherals and the USB-connected central.
      Pairs with the Kibodo macOS app.

      Enable on every device in your split (central AND peripherals).
      Subfeatures auto-select based on the ZMK split role.

if KIBODO

config KIBODO_HID
    bool "Expose battery HID report over USB (central)"
    depends on ZMK_SPLIT_ROLE_CENTRAL && ZMK_USB
    default y
    help
      On the central dongle, exposes a vendor-defined USB HID interface
      carrying per-peripheral battery levels, side labels, and
      (optionally) active-layer state.

config KIBODO_PERIPHERAL
    bool "Expose per-half side label via BLE (peripheral)"
    depends on !ZMK_SPLIT_ROLE_CENTRAL && BT
    default y
    help
      On the split peripherals, exposes a custom GATT service with
      a single side-label characteristic. The central reads it once
      per connection to populate the peripheral's name in the HID
      report sent to the host.

config KIBODO_SIDE_LABEL
    string "Side label shown in the companion app"
    depends on KIBODO_PERIPHERAL
    default ""
    help
      Human-readable name for this half, e.g. "Corne Left" or
      "Sofle Right". Empty means the app falls back to "Peripheral N".
      Set this in the shield override .conf for each half
      (e.g. config/corne_left.conf, config/corne_right.conf).

config KIBODO_HID_HEARTBEAT_SEC
    int "Heartbeat interval for HID report (seconds)"
    depends on KIBODO_HID
    default 60
    help
      How often the central resends the current report as a liveness
      signal. Purely dongle→host USB traffic; does not touch BLE
      and does not prevent peripheral deep sleep.

config KIBODO_LAYER
    bool "Report active layer over USB HID (central)"
    depends on KIBODO_HID
    default y
    help
      On the central dongle, includes the active-layer index and layer
      labels in the vendor HID report stream. Uses the same resolution
      as ZMK's on-dongle layer display (highest active layer).

module = KIBODO
module-str = KIBODO
source "${ZEPHYR_BASE}/subsys/logging/Kconfig.template.log_config"

endif # KIBODO

config USB_HID_DEVICE_COUNT
    default 2 if KIBODO_HID
```
